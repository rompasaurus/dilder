/**
 * Supportive Octopus — Standalone e-ink animation
 *
 * Same octopus, aggressively supportive energy. Boots directly into
 * the animation with no USB connection required.  Frames are
 * pre-rendered by the DevTool and baked into frames.h at build time.
 *
 * The display cycles through expressions (smirk, open mouth,
 * big smile) while showing random supportive quotes in a chat bubble.
 *
 * Uses partial refresh after the first frame for faster animation.
 * Each frame displays for ~4 seconds (e-ink friendly).
 *
 * Wiring (same as all Dilder firmware):
 *   VCC  -> 3V3(OUT) pin 36
 *   GND  -> GND      pin 38
 *   DIN  -> GP11     pin 15  (SPI1 TX)
 *   CLK  -> GP10     pin 14  (SPI1 SCK)
 *   CS   -> GP9      pin 12  (SPI1 CSn)
 *   DC   -> GP8      pin 11
 *   RST  -> GP12     pin 16
 *   BUSY -> GP13     pin 17
 */

#include <stdio.h>
#include <stdlib.h>
#include <string.h>
#include "pico/stdlib.h"
#include "DEV_Config.h"

/*
 * Display variant selection — set via -DDISPLAY_VARIANT=X at build time.
 * Supported: V2, V3 (default), V3a, V4
 */
#if defined(DISPLAY_V2)
  #include "EPD_2in13_V2.h"
  #define DISP_W          EPD_2in13_V2_WIDTH
  #define DISP_H          EPD_2in13_V2_HEIGHT
  #define EPD_Init()      EPD_2in13_V2_Init()
  #define EPD_Clear()     EPD_2in13_V2_Clear()
  #define EPD_Display(b)  EPD_2in13_V2_Display(b)
  #define EPD_Partial(b)  EPD_2in13_V2_Display_Partial(b)
  #define EPD_Sleep()     EPD_2in13_V2_Sleep()
  #define DISPLAY_NAME    "V2"
#elif defined(DISPLAY_V3A)
  #include "EPD_2in13_V3a.h"
  #define DISP_W          EPD_2in13_V3a_WIDTH
  #define DISP_H          EPD_2in13_V3a_HEIGHT
  #define EPD_Init()      EPD_2in13_V3a_Init()
  #define EPD_Clear()     EPD_2in13_V3a_Clear()
  #define EPD_Display(b)  EPD_2in13_V3a_Display(b)
  #define EPD_Partial(b)  EPD_2in13_V3a_Display_Partial(b)
  #define EPD_Sleep()     EPD_2in13_V3a_Sleep()
  #define DISPLAY_NAME    "V3a"
#elif defined(DISPLAY_V4)
  #include "EPD_2in13_V4.h"
  #define DISP_W          EPD_2in13_V4_WIDTH
  #define DISP_H          EPD_2in13_V4_HEIGHT
  #define EPD_Init()      EPD_2in13_V4_Init()
  #define EPD_Clear()     EPD_2in13_V4_Clear()
  #define EPD_Display(b)  EPD_2in13_V4_Display(b)
  #define EPD_Partial(b)  EPD_2in13_V4_Display_Partial(b)
  #define EPD_Sleep()     EPD_2in13_V4_Sleep()
  #define DISPLAY_NAME    "V4"
#else
  #include "EPD_2in13_V3.h"
  #define DISP_W          EPD_2in13_V3_WIDTH
  #define DISP_H          EPD_2in13_V3_HEIGHT
  #define EPD_Init()      EPD_2in13_V3_Init()
  #define EPD_Clear()     EPD_2in13_V3_Clear()
  #define EPD_Display(b)  EPD_2in13_V3_Display(b)
  #define EPD_Partial(b)  EPD_2in13_V3_Display_Partial(b)
  #define EPD_Sleep()     EPD_2in13_V3_Sleep()
  #define DISPLAY_NAME    "V3"
#endif

/* Landscape dimensions (what DevTool renders) */
#define IMG_W    250
#define IMG_H    122
#define IMG_ROW_BYTES  ((IMG_W + 7) / 8)   /* 32 */
#define IMG_TOTAL      (IMG_ROW_BYTES * IMG_H)  /* 3904 */

/* Pre-rendered frames (generated by DevTool) */
#include "frames.h"

/* Display buffer (native portrait orientation) */
static uint8_t display_buf[((DISP_W + 7) / 8) * DISP_H];

/**
 * Transpose a landscape frame (250x122, DevTool format) into the
 * native display orientation (122x250, portrait) for the e-ink driver.
 *
 * DevTool: pixel(x,y) where x=[0..249], y=[0..121], 1=black, MSB first
 * Display: pixel(y, 249-x), 0=black (inverted), MSB first
 */
static void transpose_to_display(const uint8_t *src) {
    uint16_t dst_row_bytes = (DISP_W + 7) / 8;  /* 16 */
    memset(display_buf, 0xFF, sizeof(display_buf));  /* white */

    for (int y = 0; y < IMG_H; y++) {
        for (int x = 0; x < IMG_W; x++) {
            /* Read source pixel */
            int src_byte = y * IMG_ROW_BYTES + x / 8;
            int src_bit  = 7 - (x % 8);
            int pixel    = (src[src_byte] >> src_bit) & 1;

            if (pixel) {  /* 1 = black in DevTool format */
                int dx = y;
                int dy = 249 - x;
                int dst_byte = dy * dst_row_bytes + dx / 8;
                int dst_bit  = 7 - (dx % 8);
                display_buf[dst_byte] &= ~(1 << dst_bit);  /* 0 = black for e-ink */
            }
        }
    }
}

int main(void) {
    /* Initialize USB serial (optional, for debug) */
    stdio_init_all();
    sleep_ms(1000);

    printf("Supportive Octopus starting (display: %s)...\n", DISPLAY_NAME);

    /* Initialize hardware */
    if (DEV_Module_Init() != 0) {
        printf("ERROR: Hardware init failed.\n");
        return 1;
    }

    /* Initialize display */
    EPD_Init();
    EPD_Clear();
    printf("Display ready. %d frames loaded.\n", FRAME_COUNT);

    /* Animation loop — runs forever */
    uint32_t frame_idx = 0;

    while (true) {
        /* Get the current frame data */
        const uint8_t *frame = frames[frame_idx % FRAME_COUNT];

        /* Transpose landscape -> portrait */
        transpose_to_display(frame);

        /* Display the frame */
        if (frame_idx == 0) {
            /* First frame: full refresh (clean baseline) */
            EPD_Display(display_buf);
        } else {
            /* Subsequent: partial refresh (much faster, ~0.3s) */
            EPD_Partial(display_buf);
        }

        printf("Frame %lu/%d displayed.\n",
               (unsigned long)(frame_idx % FRAME_COUNT) + 1, FRAME_COUNT);

        frame_idx++;

        /* Wait between frames (e-ink friendly interval) */
        sleep_ms(4000);
    }

    return 0;
}
